## boards/shields/licorice1 - dongle/Kconfig.shield
```kconfig
config SHIELD_LICORICE1_DONGLE
    def_bool $(shields_list_contains,licorice1_dongle)

config SHIELD_LICORICE1_LEFT
    def_bool $(shields_list_contains,licorice1_left)

config SHIELD_LICORICE1_RIGHT
    def_bool $(shields_list_contains,licorice1_right)
```

## boards/shields/licorice1 - no dongle/Kconfig.shield
```kconfig
config SHIELD_LICORICE1_LEFT
    def_bool $(shields_list_contains,licorice1_left)

config SHIELD_LICORICE1_RIGHT
    def_bool $(shields_list_contains,licorice1_right)
```

## boards/shields/licorice1/Kconfig.defconfig
```kconfig
if SHIELD_LICORICE1_LEFT

config ZMK_KEYBOARD_NAME
    default "licorice"

config ZMK_SPLIT_ROLE_CENTRAL
    default y

endif # SHIELD_LICORICE1_LEFT

if SHIELD_LICORICE1_LEFT || SHIELD_LICORICE1_RIGHT

config ZMK_SPLIT
    default y

endif # SHIELD_LICORICE1_LEFT || SHIELD_LICORICE1_RIGHT
```
